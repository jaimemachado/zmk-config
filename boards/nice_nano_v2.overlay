#include <dt-bindings/led/led.h>

/ {
    led_strip: ws2812@0 {
        compatible = "worldsemi,ws2812-spi";
        reg = <0>; /* SPI, required but ignored */
        spi-max-frequency = <4000000>;

        /* Set the correct pin for Nice!Nano v2 underglow (e.g., P0.17) */
        pinctrl-0 = <&ws2812_pins>;
        pinctrl-names = "default";
        chain-length = <30>; /* Number of LEDs in your strip */

        spi-one-frame = <0x70>;
        spi-zero-frame = <0x40>;

        color-mapping = <LED_COLOR_ID_GREEN LED_COLOR_ID_RED LED_COLOR_ID_BLUE>;
    };

    ws2812_pins: ws2812_pins {
        /* P0.08 is commonly used for underglow on Nice!Nano v2 */
        pins = <8>;
    };

    chosen {
        zmk,underglow = &led_strip;
    };
};
